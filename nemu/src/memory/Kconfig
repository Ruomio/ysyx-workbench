## nemu/src/memory/Kconfig
```kconfig
menu "Memory Configuration"

config MBASE
  hex "Memory base address"
  default 0x0        if ISA_x86
  default 0x80000000

config MSIZE
  hex "Memory size"
  default 0x8000000

config PC_RESET_OFFSET
  hex "Offset of reset vector from the base of memory"
  default 0x100000 if ISA_x86
  default 0

choice
  prompt "Physical memory definition"
  default PMEM_GARRAY
config PMEM_MALLOC
  bool "Using malloc()"
config PMEM_GARRAY
  depends on !TARGET_AM
  bool "Using global array"
endchoice

config MEM_RANDOM
  depends on MODE_SYSTEM && !DIFFTEST && !TARGET_AM
  bool "Initialize the memory with random values"
  default y
  help
    This may help to find undefined behaviors.

config IS_SRAM
  # depends on TARGET_SHARE
  bool "enable mrom and sram to adapt ysyxsoc difftest"
  default y

config SRAM_BASE
  depends on IS_SRAM
  hex "SRAM base address"
  default 0x0f000000

config SRAM_SIZE
  depends on IS_SRAM
  hex "SRAM size, defalut 8k"
  default 0x2000

config IS_PSRAM
  # depends on TARGET_SHARE
  bool "enable psram to adapt ysyxsoc difftest"
  default y

config PSRAM_BASE
  depends on IS_PSRAM
  hex "PSRAM base address"
  default 0x80000000

config PSRAM_SIZE
  depends on IS_PSRAM
  hex "PSRAM size, defalut 4M"
  default 0x400000

config IS_SDRAM
  # depends on TARGET_SHARE
  bool "enable sdram to adapt ysyxsoc difftest"
  default y

config SDRAM_BASE
  depends on IS_SDRAM
  hex "SDRAM base address"
  default 0xa0000000

config SDRAM_SIZE
  depends on IS_SDRAM
  hex "PSRAM size, defalut 32M"
  default 0x2000000

endmenu #MEMORY
```

## npc/Kconfig
```kconfig
mainmenu "NPC Configuration"

choice
    prompt "Select ISA"
    default ISA_riscv32
config ISA_riscv32
    bool "select riscv32"
config ISA_riscv64
    bool "selsec riscv64"
endchoice

config ISA
  string
  default "x86" if ISA_x86
  default "mips32" if ISA_mips32
  default "riscv32" if ISA_riscv32
  default "riscv64" if ISA_riscv64
  default "loongarch32r" if ISA_loongarch32r
  default "none"

config E_EXTENSION
    bool "enable RISCV E EXTENSION"
    default yes

config REGS_NUM
    int "Number of registers"
    default "32" if !E_EXTENSION
    default "16" if E_EXTENSION

menu "Build options"
    config DEBUG
        bool "is enable -g parameter when compiling"
        default n

    config NVBOARD
        bool "enable nvboard"
        default n

    config WAVEFILE
        bool "is generate wave file"
        default n

    config MAX_WAVE_STEP
        depends on WAVEFILE
        int "Max wave step"
        default "20000"

    config BASE_WAVE_STEP
        depends on WAVEFILE
        int "Base wave step"
        default "0"

    config LIGHTSSS
        depends on !WAVEFILE
        bool "is enable lightsss"
        default y
endmenu

menu "Memory setting"
    config MBASE
        hex "Memory base address"
        default "0x0"
    config MSIZE
        hex "Memory size"
        default "0x0"

    config PSRAM
        bool "enable PSRAM"
        default y
    config PSRAM_BASE
        depends on PSRAM
        hex "PSRAM address"
        default "0x80000000"
    config PSRAM_SIZE
        depends on PSRAM
        hex "PSRAM size, default 4M"
        default "0x00400000"

    config SDRAM
        bool "enable SDRAM"
        default y
    config SDRAM_BASE
        depends on SDRAM
        hex "SDRAM address"
        default "0xa0000000"
    config SDRAM_SIZE
        depends on SDRAM
        hex "SDRAM size, default 32M"
        default "0x02000000"

    config SRAM
        bool "enable SRAM"
        default y
    config SRAM_BASE
        depends on SRAM
        hex "SRAM address"
        default "0x0f000000"
    config SRAM_SIZE
        depends on SRAM
        hex "SRAM size, default 8K"
        default "0x00002000"

endmenu

menu "Test and debug"
    config ITRACE
        bool "enable inst trace"
        default n
    config MTRACE
        bool "enable memory trace"
        default n
    config FTRACE
        bool "enable function trace"
        default n
    config WATCH_POINT
        bool "enable watch point"
        default n
    config DIFFTEST
        bool "enable difftest"
        default n
endmenu

menuconfig DEVICE
    bool "Device"
    default n
    help
        Provide devices support for NPC.

if DEVICE
menuconfig HAS_SERIAL
    bool "Enable serial"
    default y

if HAS_SERIAL
config SERIAL_MMIO
    hex "Memory address of serial controller"
    default 0xa00003f8
endif

menuconfig HAS_TIMER
    bool "Enable timer"
    default y

if HAS_TIMER
config RTC_MMIO
    hex "Memory address of timer controller"
    default 0xa0000048
endif

endif # endif DEVICES
```
